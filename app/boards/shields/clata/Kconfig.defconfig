## app/boards/shields/macropadh/Kconfig.defconfig
```kconfig
# Copyright (c) 2022 The ZMK Contributors
# SPDX-License-Identifier: MIT

if SHIELD_MACROPADH

config ZMK_KEYBOARD_NAME
    default "macropadh"

endif
```

## app/boards/shields/macropadh/Kconfig.shield
```kconfig
# Copyright (c) 2022 The ZMK Contributors
# SPDX-License-Identifier: MIT
config SHIELD_MACROPADH
    def_bool $(shields_list_contains,macropadh)
```
